## meta-openbmc-machines/meta-flex/conf/layer.conf
```bitbake
# We have a conf and classes directory, add to BBPATH
BBPATH .= ":${LAYERDIR}"

# We have recipes-* directories, add to BBFILES
BBFILES += "${LAYERDIR}/common/recipes-*/*/*.bb \
            ${LAYERDIR}/common/recipes-*/*/*.bbappend"

BBFILE_COLLECTIONS += "flex"
BBFILE_PATTERN_flex = "^${LAYERDIR}/"
LAYERVERSION_flex = "1"
```
